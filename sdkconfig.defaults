## sdkconfig.defaults
```kconfig
# ==== Partition table ====
CONFIG_PARTITION_TABLE_CUSTOM=y
CONFIG_PARTITION_TABLE_CUSTOM_FILENAME="partitions.csv"
CONFIG_PARTITION_TABLE_FILENAME="partitions.csv"
CONFIG_PARTITION_TABLE_OFFSET=0x8000

# ==== SPIFFS ====
CONFIG_SPIFFS_MAX_PARTITIONS=3
CONFIG_SPIFFS_PAGE_CHECK=y
CONFIG_SPIFFS_USE_MAGIC=y
CONFIG_SPIFFS_USE_MAGIC_LENGTH=y
CONFIG_SPIFFS_USE_MTIME=y

# ==== FATFS (SD Card) ====
CONFIG_FATFS_CODEPAGE_437=y
CONFIG_FATFS_LFN_HEAP=y
CONFIG_FATFS_FS_LOCK=8
CONFIG_FATFS_PER_FILE_CACHE=y

# ==== SDMMC Host ====
CONFIG_SDMMC_USE_GPIO=y
CONFIG_SDMMC_SLOT_1=y
CONFIG_SDMMC_SLOT_1_WP=-1
CONFIG_SDMMC_SLOT_1_CD=-1

# ==== WiFi ====
CONFIG_ESP_WIFI_AUTH_OPEN=y
CONFIG_ESP_WIFI_SOFTAP_SUPPORT=y
CONFIG_ESP_WIFI_STATIC_RX_BUFFER_NUM=16
CONFIG_ESP_WIFI_DYNAMIC_RX_BUFFER_NUM=32

# ==== LWIP ====
CONFIG_LWIP_LOCAL_HOSTNAME="esp32-logger"
CONFIG_LWIP_MAX_SOCKETS=10

# ==== Logging ====
CONFIG_LOG_DEFAULT_LEVEL_INFO=y
CONFIG_LOG_COLORS=y

# ==== FreeRTOS ====
CONFIG_FREERTOS_HZ=1000
CONFIG_FREERTOS_USE_IDLE_HOOK=y
CONFIG_FREERTOS_USE_TICK_HOOK=y
CONFIG_FREERTOS_ASSERT_ON_UNTESTED_FUNCTION=y

# ==== mDNS (optional) ====
CONFIG_MDNS_ENABLE=y
```
